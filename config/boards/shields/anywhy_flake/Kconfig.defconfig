## config/boards/shields/anywhy_flake/Kconfig.shield
```kconfig
# --- standalone (no dongle) ---
config SHIELD_ANYWHY_FLAKE_LEFT
    def_bool $(shields_list_contains,anywhy_flake_left)

config SHIELD_ANYWHY_FLAKE_RIGHT
    def_bool $(shields_list_contains,anywhy_flake_right)

# --- dongle setup ---
config SHIELD_ANYWHY_FLAKE_CENTRAL_DONGLE
    def_bool $(shields_list_contains,anywhy_flake_central_dongle)

config SHIELD_ANYWHY_FLAKE_PERIPHERAL_LEFT
    def_bool $(shields_list_contains,anywhy_flake_peripheral_left)

config SHIELD_ANYWHY_FLAKE_PERIPHERAL_RIGHT
    def_bool $(shields_list_contains,anywhy_flake_peripheral_right)
```

## config/boards/shields/charybdis/Kconfig.shield
```kconfig
# Copyright (c) 2022 Duccio Breschi
# SPDX-License-Identifier: MIT

# --- standalone (no dongle) ---
config SHIELD_CHARYBDIS_LEFT
    def_bool $(shields_list_contains,charybdis_left)

config SHIELD_CHARYBDIS_RIGHT
    def_bool $(shields_list_contains,charybdis_right)

# --- dongle setup ---
config SHIELD_CHARYBDIS_CENTRAL_DONGLE
    def_bool $(shields_list_contains,charybdis_central_dongle)

config SHIELD_CHARYBDIS_PERIPHERAL_LEFT
    def_bool $(shields_list_contains,charybdis_peripheral_left)

config SHIELD_CHARYBDIS_PERIPHERAL_RIGHT
    def_bool $(shields_list_contains,charybdis_peripheral_right)
```
