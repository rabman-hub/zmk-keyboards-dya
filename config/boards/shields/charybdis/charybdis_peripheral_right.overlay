/*
 * Charybdis — right half as a BLE peripheral (dongle setup).
 * This half owns the PMW3610 trackball; its events are forwarded to the
 * dongle over BLE via the input-split declared in charybdis.dtsi.
 */

#include "charybdis.dtsi"
#include "charybdis-trackball.dtsi"

&default_transform {
    col-offset = <6>;
};

&kscan0 {
    diode-direction = "col2row";
    col-gpios
        = <&pro_micro 9 (GPIO_ACTIVE_HIGH)> // COL0
        , <&pro_micro 8 (GPIO_ACTIVE_HIGH)> // COL1
        , <&pro_micro 7 (GPIO_ACTIVE_HIGH)> // COL2
        , <&pro_micro 6 (GPIO_ACTIVE_HIGH)> // COL3
        , <&pro_micro 5 (GPIO_ACTIVE_HIGH)> // COL4
        , <&pro_micro 4 (GPIO_ACTIVE_HIGH)> // COL5
    ;
};

/*
 * Point the shared input-split at the local sensor. The listener stays
 * DISABLED here — it is enabled only on the central. Enabling it on both
 * sides would double-report movement.
 */
&trackball_split {
    status = "okay";
    device = <&trackball>;
};
